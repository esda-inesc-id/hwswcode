# IOB-AXIL-MACC-IOB: IP-XACT component
VLNV IObundle:IP:IOB-AXIL-MACC-IOB:0.81
The IObundle AXIL_MACC is a RISC-V-based Peripheral written in Verilog, which users can download for free, modify, simulate and implement in FPGA or ASIC. It is written in Verilog and includes a C software driver. The IObundle AXIL_MACC is a very compact IP that works at high clock rates if needed. It supports full-duplex operation and a configurable baud rate. The IObundle AXIL_MACC has a fixed configuration for the Start and Stop bits. More flexible licensable commercial versions are available upon request.

## Parameters
DATA_W = 32 — Data bus width.
VERSION = 16'h0081 — Product version. This 16-bit macro uses nibbles to represent decimal numbers using their binary values. The two most significant nibbles represent the integral part of the version, and the two least significant nibbles represent the decimal part. For example V12.34 is represented by 0x1234.

## Bus interfaces (logical=physical port)
clk_en_rst_s: slave IObundle:CLK:iob_clk:1.0 — Clock, clock enable and reset
  =, =, =
iob_csrs_cbus_s: slave IObundle:IOb:iob:1.0 — Control and Status Registers interface (auto-generated)
  =, =, =, =, =, =, =, =

## Ports
in clk_i[0:0] — Clock
in cke_i[0:0] — Clock enable
in arst_i[0:0] — Asynchronous active-high reset
in iob_csrs_iob_valid_i[0:0] — Request address is valid.
in iob_csrs_iob_addr_i[1:0] — Address.
in iob_csrs_iob_wdata_i[DATA_W_ID-1:0] — Write data.
in iob_csrs_iob_wstrb_i[DATA_W_ID/8-1:0] — Write strobe.
out iob_csrs_iob_rvalid_o[0:0] — Read data valid.
out iob_csrs_iob_rdata_o[DATA_W_ID-1:0] — Read data.
out iob_csrs_iob_ready_o[0:0] — Interface ready.
in iob_csrs_iob_rready_i[0:0] — Read data ready.

## Address spaces and blocks
CSR.CSR_REGS: base 0, range 10, width 32, register

## Registers
Registers are 8-bit, write-only, reset 0x0 unless marked. A register's access mark holds for its fields unless they carry their own. Offsets are from the block's base; lines under a group give offsets from that group; [hi:lo] are bit positions; {n}, {i} and the like mark numbered series; 'fields as' and 'values as' point back to an identical list; <NAME> marks a mode.

## CSR.CSR_REGS
Base 0x00000000
0x00 en — Enable.
  [0] en
0x01 done ro
  [0] done
0x02 load
  [0] load
0x03 a — Operand A.
0x04 b — Operand B.
0x06 c 16-bit ro — Operand C.
0x08 version 16-bit ro reset 0x51 — Product version. This 16-bit register uses nibbles to represent decimal numbers using their binary values. The two most significant nibbles represent the integral part of the version, and the two least significant nibbles represent the decimal part. For example V12.34 is represented by 0x1234.

## Notices in the file
MIT License, Copyright (c) 2025
