# IOB-AXIL-MACC-AXIL: IP-XACT component
VLNV IObundle:IP:IOB-AXIL-MACC-AXIL:0.81
The IObundle AXIL_MACC is a RISC-V-based Peripheral written in Verilog, which users can download for free, modify, simulate and implement in FPGA or ASIC. It is written in Verilog and includes a C software driver. The IObundle AXIL_MACC is a very compact IP that works at high clock rates if needed. It supports full-duplex operation and a configurable baud rate. The IObundle AXIL_MACC has a fixed configuration for the Start and Stop bits. More flexible licensable commercial versions are available upon request.

## Parameters
DATA_W = 32 — Data bus width.
VERSION = 16'h0081 — Product version. This 16-bit macro uses nibbles to represent decimal numbers using their binary values. The two most significant nibbles represent the integral part of the version, and the two least significant nibbles represent the decimal part. For example V12.34 is represented by 0x1234.

## Bus interfaces (logical=physical port)
clk_en_rst_s: slave IObundle:CLK:iob_clk:1.0 — Clock, clock enable and reset
  =, =, =
iob_csrs_cbus_s: slave ARM:AXI:axil:4.0 — Control and Status Registers interface (auto-generated)
  =, =, =, =, =, =, =, =, =, =, =, =, =, =, =, =, =

## Ports
in clk_i[0:0] — Clock
in cke_i[0:0] — Clock enable
in arst_i[0:0] — Asynchronous active-high reset
in iob_csrs_axil_araddr_i[1:0] — Address read channel address.
in iob_csrs_axil_arvalid_i[0:0] — Address read channel valid.
out iob_csrs_axil_arready_o[0:0] — Address read channel ready.
out iob_csrs_axil_rdata_o[DATA_W_ID-1:0] — Read channel data.
out iob_csrs_axil_rresp_o[1:0] — Read channel response.
out iob_csrs_axil_rvalid_o[0:0] — Read channel valid.
in iob_csrs_axil_rready_i[0:0] — Read channel ready.
in iob_csrs_axil_awaddr_i[1:0] — Address write channel address.
in iob_csrs_axil_awvalid_i[0:0] — Address write channel valid.
out iob_csrs_axil_awready_o[0:0] — Address write channel ready.
in iob_csrs_axil_wdata_i[DATA_W_ID-1:0] — Write channel data.
in iob_csrs_axil_wstrb_i[DATA_W_ID/8-1:0] — Write channel write strobe.
in iob_csrs_axil_wvalid_i[0:0] — Write channel valid.
out iob_csrs_axil_wready_o[0:0] — Write channel ready.
out iob_csrs_axil_bresp_o[1:0] — Write response channel response.
out iob_csrs_axil_bvalid_o[0:0] — Write response channel valid.
in iob_csrs_axil_bready_i[0:0] — Write response channel ready.

## Address spaces and blocks
CSR.CSR_REGS: base 0, range 10, width 32, register

## Registers
Registers are 8-bit, write-only, reset 0x0 unless marked. A register's access mark holds for its fields unless they carry their own. Offsets are from the block's base; lines under a group give offsets from that group; [hi:lo] are bit positions; {n}, {i} and the like mark numbered series; 'fields as' and 'values as' point back to an identical list; <NAME> marks a mode.

## CSR.CSR_REGS
Base 0x00000000
0x00 en — Enable.
  [0] en
0x01 done ro
  [0] done
0x02 load
  [0] load
0x03 a — Operand A.
0x04 b — Operand B.
0x06 c 16-bit ro — Operand C.
0x08 version 16-bit ro reset 0x51 — Product version. This 16-bit register uses nibbles to represent decimal numbers using their binary values. The two most significant nibbles represent the integral part of the version, and the two least significant nibbles represent the decimal part. For example V12.34 is represented by 0x1234.

## Notices in the file
MIT License, Copyright (c) 2025
